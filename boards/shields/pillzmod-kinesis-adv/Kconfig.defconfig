## boards/shields/pillzmod-kinesis-adv/Kconfig.defconfig
```kconfig
# Copyright (c) 2020 The ZMK Contributors
# SPDX-License-Identifier: MIT

if SHIELD_PILLZMOD_KINESIS_ADV

config ZMK_KEYBOARD_NAME
    default "Pillzmod Kinesis Advantage"

endif
```
